
#include <SPI.h>
#include <Wire.h>
#include <Adafruit_GFX.h>
#include <Adafruit_SSD1306.h>

#define SCREEN_WIDTH 128 // OLED display width, in pixels
#define SCREEN_HEIGHT 64 // OLED display height, in pixels

// Declaration for an SSD1306 display connected to I2C (SDA, SCL pins)
// The pins for I2C are defined by the Wire-library.
// On an arduino UNO:       A4(SDA), A5(SCL)
// On an arduino MEGA 2560: 20(SDA), 21(SCL)
// On an arduino LEONARDO:   2(SDA),  3(SCL), ...
#define OLED_RESET     -1 // Reset pin # (or -1 if sharing Arduino reset pin)
#define SCREEN_ADDRESS 0x3C ///< See datasheet for Address; 0x3D for 128x64, 0x3C for 128x32
Adafruit_SSD1306 display(SCREEN_WIDTH, SCREEN_HEIGHT, &Wire, OLED_RESET);

const unsigned char PROGMEM logo_btc [] = {
 //btc logo
0xff, 0xff, 0xff, 0xff, 0xff, 0xff, 0xc0, 0xff, 0xff, 0xe0, 0x01, 0xff, 0xff, 0xc0, 0xff, 0xff, 
0x00, 0x00, 0x3f, 0xff, 0xc0, 0xff, 0xfc, 0x00, 0x00, 0x0f, 0xff, 0xc0, 0xff, 0xf0, 0x00, 0x00, 
0x03, 0xff, 0xc0, 0xff, 0xe0, 0x00, 0x00, 0x01, 0xff, 0xc0, 0xff, 0x80, 0x00, 0x00, 0x00, 0xff, 
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0xff, 0xff, 0xf8, 0x07, 0xff, 0xff, 0xc0, 0xff, 0xff, 0xff, 0xff, 0xff, 0xff, 0xc0
};


const char btcstr [] = {
  'B', 'i', 't', 'c', 'o', 'i', 'n'
};

void setup() {
  // put your setup code here, to run once:
  Serial.begin(9600);

  // SSD1306_SWITCHCAPVCC = generate display voltage from 3.3V internally
  if (!display.begin(SSD1306_SWITCHCAPVCC, 0x3C)) {
    Serial.println(F("SSD1306 allocation failed"));
    for (;;); // Don't proceed, loop forever
  }

  // Show initial display buffer contents on the screen --
  // the library initializes this with an Adafruit splash screen.
//  display.display();
//  delay(2000); // Pause for 2 seconds
  // Clear the buffer
  display.clearDisplay();
    drawbitmap(logo_btc);
//    delay(3000);
drawchar(btcstr, sizeof(btcstr));
}

void loop() {
  // put your main code here, to run repeatedly:

}

void drawbitmap(char bitmap[]) {
  display.clearDisplay();

  display.drawBitmap(32, 16, logo_btc, 50, 50, 1);
  display.display();
}

void drawchar(char input[], size_t size) {
  Serial.println(size);
  display.setTextSize(1);      // Normal 1:1 pixel scale
  display.setTextColor(SSD1306_WHITE); // Draw white text
  int cursorx = (SCREEN_WIDTH/4)+(size/2);
  display.setCursor(cursorx, 0);     // Start at top-left corner
  display.cp437(true);         // Use full 256 char 'Code Page 437' font
  // Not all the characters will fit on the display. This is normal.
  // Library will draw what it can and the rest will be clipped.
  for (int16_t i = 0; i < size; i++) {
    Serial.println(input[i]);
    display.write(input[i]);
  }

  display.display();
}
